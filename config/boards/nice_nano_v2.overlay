/*
 * OLED configuration for 0.91" SSD1306 (128x32)
 * Try I2C address 0x3D instead of 0x3C
 */

&pro_micro_i2c {
    status = "okay";

    oled: ssd1306@3d {
        compatible = "solomon,ssd1306fb";
        reg = <0x3d>;
        width = <128>;
        height = <32>;
        segment-offset = <0>;
        page-offset = <0>;
        display-offset = <0>;
        multiplex-ratio = <31>;
        segment-remap;
        com-invdir;
        com-sequential;
        inversion-on;
        prechargep = <0x22>;
    };
};